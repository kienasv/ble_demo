## ble_demo_nrf52840/Kconfig.board
```kconfig
# BLE DEMO NRF52840 board configuration

# Copyright (c) 2016 Nordic Semiconductor ASA
# SPDX-License-Identifier: Apache-2.0

config BOARD_BLEDEMO_NRF52840
	bool "BLE DEMO NRF52840"
	depends on SOC_NRF52840_QIAA
```

## ble_demo_nrf52840/Kconfig.defconfig
```kconfig
# BLE DEMO NRF52840 board configuration

# Copyright (c) 2016 Nordic Semiconductor ASA
# SPDX-License-Identifier: Apache-2.0

if BOARD_BLEDEMO_NRF52840

config BOARD
	default "ble_demo_nrf52840"

if USB

config USB_NRFX
	default y

config USB_DEVICE_STACK
	default y

endif # USB

config BT_CTLR
	default BT

endif # BOARD_BLEDEMO_NRF52840
```
